## esp/sdkconfig.defaults
```kconfig
# ESP32-S3 common sdkconfig defaults
# Board-specific settings (flash size, partition table, etc.) in sdkconfig.board.*

# Target
CONFIG_IDF_TARGET="esp32s3"

# Bluetooth controller only (VHCI for BTstack — no ESP-IDF host stack)
CONFIG_BT_ENABLED=y
CONFIG_BT_CONTROLLER_ENABLED=y
CONFIG_BT_CONTROLLER_ONLY=y
CONFIG_BT_CONTROLLER_MODE_BLE_ONLY=y

# Stack sizes
CONFIG_ESP_MAIN_TASK_STACK_SIZE=16384

# USB OTG (TinyUSB device) — UART console, not USB JTAG
CONFIG_SOC_USB_OTG_SUPPORTED=y
CONFIG_ESP_CONSOLE_UART_DEFAULT=y
CONFIG_ESP_CONSOLE_USB_SERIAL_JTAG=n

# Disable watchdog for development
CONFIG_ESP_TASK_WDT_EN=n
```

## nrf/boards/aprbrother_nrf52840.conf
```kconfig
# April Brother nRF52840 USB Dongle board-specific config
#
# Ships the Adafruit nRF52 UF2 bootloader (no SoftDevice; code at 0x1000).
# Zephyr's default DTS for nrf52840dongle uses MCUboot partitions — the overlay
# replaces them with the UF2 layout. This is the board sent to MouthPad users.
CONFIG_USE_DT_CODE_PARTITION=y
CONFIG_BOOTLOADER_MCUBOOT=n
CONFIG_BOARD_HAS_NRF5_BOOTLOADER=n
```
